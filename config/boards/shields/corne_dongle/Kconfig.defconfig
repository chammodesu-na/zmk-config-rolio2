## config/boards/shields/corne_dongle/Kconfig.defconfig
```kconfig
if SHIELD_CORNE_DONGLE

config ZMK_KEYBOARD_NAME
    default "Corne"

config ZMK_SPLIT_ROLE_CENTRAL
    default y

config ZMK_USB
    default y

config ZMK_SPLIT_BLE_CENTRAL_PERIPHERALS
    default 2

config BT_MAX_CONN
    default 5

config BT_MAX_PAIRED
    default 5

# USB Composite Device 설정
config USB_DEVICE_STACK
    default y

config USB_COMPOSITE_DEVICE
    default y

# Serial 설정
config SERIAL
    default y

config UART_INTERRUPT_DRIVEN
    default y

config UART_LINE_CTRL
    default y

config USB_CDC_ACM
    default y

# Dongle Status Serial 활성화
config DONGLE_STATUS_SERIAL
    default y

endif

if SHIELD_CORNE_LEFT || SHIELD_CORNE_RIGHT || SHIELD_CORNE_DONGLE

config ZMK_SPLIT
    default y

if ZMK_DISPLAY

config I2C
    default y

config SSD1306
    default y

endif # ZMK_DISPLAY

if LVGL

config LV_Z_VDB_SIZE
    default 64

config LV_DPI_DEF
    default 96

config LV_Z_BITS_PER_PIXEL
    default 1

choice LV_COLOR_DEPTH
    default LV_COLOR_DEPTH_1
endchoice

endif # LVGL

endif

# DONGLE_STATUS_SERIAL 정의
config DONGLE_STATUS_SERIAL
    bool "Enable dongle status serial output"
    default n
    depends on SHIELD_CORNE_DONGLE
    help
      Enable USB serial output for dongle status information
```

## config/boards/shields/sofle/Kconfig.defconfig
```kconfig
# Copyright (c) 2020 Ryan Cross
# SPDX-License-Identifier: MIT

if SHIELD_SOFLE_LEFT

config ZMK_KEYBOARD_NAME
    default "Sofle"

config ZMK_SPLIT_ROLE_CENTRAL
    default y

endif

if SHIELD_SOFLE_LEFT || SHIELD_SOFLE_RIGHT

config ZMK_SPLIT
    default y

endif
```

## config/dts/bindings/behaviors/zmk,behavior-sniper-auto.yaml
```yaml
description: Sniper Auto Mouse
compatible: "zmk,behavior-sniper-auto"

properties:
  slow-layer:
    type: int
    required: true
  fast-layer:
    type: int
    required: true
  x-val:
    type: int
    required: true
    description: Fixed X movement value
  y-val:
    type: int
    required: true
    description: Fixed Y movement value
  delay-ms:
    type: int
    required: false
    default: 10
```

## config/dts/bindings/behaviors/zmk,behavior-sniper-mmv.yaml
```yaml
description: Sniper Mouse Move Behavior
compatible: "zmk,behavior-sniper-mmv"

properties:
  slow-layer:
    type: int
    required: true
    description: Layer number for Slow Mode
  fast-layer:
    type: int
    required: true
    description: Layer number for Fast Mode
  delay-ms:
    type: int
    required: false
    default: 10
    description: Polling interval in ms

  # 🔥 [여기가 핵심] const를 빼고 required: true 로 바꿨습니다.
  # 쌍따옴표 "" 안에 넣는 거 맞습니다!
  "#binding-cells":
    type: int
    required: true
```

## config/west.yml
```yaml
manifest:
  remotes:
    - name: zmkfirmware
      url-base: https://github.com/zmkfirmware
    #- name: petejohanson
    #  url-base: https://github.com/petejohanson
    # nice_oled - nice_epaper - dongle_display!view - oled Adapter
    - name: AYM1607
      url-base: https://github.com/AYM1607
    - name: englmaxi
      url-base: https://github.com/englmaxi
  projects:
    - name: zmk
      remote: zmkfirmware
      revision: v0.3
      import: app/west.yml
    - name: zmk-driver-azoteq-iqs5xx
      remote: AYM1607
      revision: main
    - name: zmk-dongle-display
      remote: englmaxi
      revision: main
  self:
    path: config
```
